## 6.0.1/bootable/bootloader/uboot-imx/board/freescale/mx6s3/Kconfig
```kconfig
if TARGET_MX6S3

config SYS_BOARD
	default "mx6s3"

config SYS_VENDOR
	default "freescale"

config SYS_SOC
	default "mx6"

config SYS_CONFIG_NAME
	default "mx6s3"

endif
```
